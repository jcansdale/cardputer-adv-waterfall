## CMakeLists.txt
```
# SPDX-License-Identifier: GPL-3.0-or-later

cmake_minimum_required(VERSION 3.20.0)

# The Cardputer-Adv is a StampS3 with this repo's shield: plain "-b m5stack_stamps3" suffices.
if(NOT DEFINED SHIELD AND NOT DEFINED CACHE{SHIELD} AND "${BOARD}" MATCHES "^m5stack_stamps3")
  set(SHIELD m5stack_cardputer_adv)
endif()

find_package(Zephyr REQUIRED HINTS $ENV{ZEPHYR_BASE})
project(esp_sdr_waterfall)

target_sources(app PRIVATE src/main.c)
# The FFTs and per-sample loops: Zephyr builds for size, and its ISO C mode turns contraction
# off (fused multiply-adds halve the FPU work).
set_source_files_properties(src/main.c PROPERTIES COMPILE_OPTIONS "-O3;-ffp-contract=fast")

# esp-dsp's ESP32-S3 float FFT kernel alone (west project esp-dsp), as apps/link takes it.
set(ESP_DSP_FFT "${WEST_TOPDIR}/modules/lib/esp-dsp/modules/fft/float/dsps_fft2r_fc32_aes3_.S")
if(NOT EXISTS "${ESP_DSP_FFT}")
  message(FATAL_ERROR "esp-dsp not found: ${ESP_DSP_FFT} (west project esp-dsp)")
endif()
target_sources(app PRIVATE "${ESP_DSP_FFT}")
set_source_files_properties(${ESP_DSP_FFT} PROPERTIES
  COMPILE_DEFINITIONS CONFIG_IDF_TARGET_ESP32S3=1
  INCLUDE_DIRECTORIES "${WEST_TOPDIR}/modules/lib/esp-dsp/modules/fft/include")
```

## sample.yaml
```
sample:
  name: ESP-SDR waterfall
  description: On-device spectrum and waterfall on the M5Stack Cardputer-Adv
common:
  tags: esp-sdr
  platform_allow:
    - m5stack_stamps3/esp32s3/procpu
  integration_platforms:
    - m5stack_stamps3/esp32s3/procpu
  extra_args:
    - SHIELD=m5stack_cardputer_adv
  harness: console
  harness_config:
    type: multi_line
    ordered: true
    regex:
      - "waterfall: radio ready"
tests:
  sample.esp_sdr.waterfall: {}
```

## prj.conf
```kconfig
# The Wi-Fi driver brings the radio up at boot; nothing may scan or connect.
CONFIG_NETWORKING=y
CONFIG_WIFI=y
CONFIG_ESP32_WIFI_STA_POWER_SAVE_NONE=y

# Burst capture at the native rates only: no ring, no PSRAM.
CONFIG_ESP_SDR=y
CONFIG_ESP_SDR_RX_DECIM=n

CONFIG_LOG=y
# uart_fifo_fill() for the binary frames to the host (64 bytes per USB packet).
CONFIG_UART_INTERRUPT_DRIVEN=y
CONFIG_CRC=y
CONFIG_PICOLIBC_IO_FLOAT=y
CONFIG_MAIN_STACK_SIZE=4096

# The ST7789V and the TCA8418 keyboard (shield m5stack_cardputer_adv).
CONFIG_DISPLAY=y
CONFIG_I2C=y

# The BMI270 accelerometer: holding the Cardputer upright switches to the portrait layout.
CONFIG_SENSOR=y

# A fixed gain is occasionally lost (doc/hardware-quirks.md): a burst then comes in at the
# AGC's gain, 14 to 20 dB up across the whole row, and peak hold keeps it. Re-forced before
# every burst (14 to 51 us each): about 1 such row in 80 with the screen on drops to 1 in 270.
CONFIG_ESP_SDR_RX_GAIN_REFRESH_MS=0
```

## boards/m5stack_stamps3_procpu.conf
```kconfig
CONFIG_FPU=y
CONFIG_FPU_SHARING=y

# The board enables PWM for its MCPWM pins, which the shield disables (they are the I2C
# clock and spare here): no PWM driver is left to build.
CONFIG_PWM=n
```

## src/spur_tables.h
```c
/* SPDX-License-Identifier: GPL-3.0-or-later */
/*
 * Generated by tools/spurs.py from spurs.npz, spurs_poweron.npz: do not edit.
 * The receiver's own lines at 80 MS/s for each whole-MHz LO from SPUR_LO_MIN to
 * SPUR_LO_MAX: spur_run[spur_idx[lo - SPUR_LO_MIN]] up to the next LO's, each the
 * first and last bin about the LO (main.c, sweep_patch()).
 */

#define SPUR_LO_MIN 1795
#define SPUR_LO_MAX 2800

static const uint16_t spur_idx[1007] = {
	0, 0, 0, 0, 0, 0, 6, 12, 18, 24, 30, 35,
	41, 48, 56, 63, 69, 75, 81, 88, 95, 103, 111, 119,
	126, 133, 139, 144, 149, 155, 161, 166, 171, 176, 182, 188,
	192, 196, 201, 206, 211, 217, 221, 226, 231, 236, 241, 245,
	249, 254, 257, 260, 261, 261, 261, 261, 261, 261, 261, 261,
	261, 261, 261, 261, 261, 261, 262, 263, 264, 264, 264, 264,
	264, 264, 264, 264, 264, 264, 264, 264, 264, 264, 264, 265,
	267, 268, 269, 269, 269, 269, 269, 269, 269, 269, 269, 269,
	269, 269, 269, 269, 269, 269, 269, 269, 269, 269, 269, 269,
	269, 269, 269, 269, 269, 269, 269, 270, 271, 272, 272, 272,
	272, 272, 272, 272, 272, 272, 272, 272, 272, 272, 272, 272,
	272, 273, 274, 275, 275, 275, 275, 275, 275, 275, 275, 275,
	275, 275, 275, 275, 275, 275, 275, 275, 275, 275, 275, 275,
	276, 277, 277, 277, 277, 277, 277, 277, 277, 277, 277, 277,
	277, 277, 277, 277, 277, 277, 277, 277, 277, 277, 277, 277,
	277, 277, 277, 277, 277, 277, 278, 279, 279, 279, 279, 279,
	279, 279, 279, 279, 279, 279, 279, 279, 279, 279, 279, 279,
	279, 279, 279, 280, 281, 281, 281, 281, 281, 281, 281, 281,
	281, 281, 281, 281, 281, 281, 281, 281, 281, 281, 281, 281,
	281, 281, 281, 281, 281, 281, 281, 281, 281, 281, 281, 281,
	281, 281, 281, 281, 281, 281, 281, 281, 281, 281, 281, 281,
	281, 281, 281, 281, 281, 281, 281, 281, 281, 281, 281, 281,
	281, 281, 281, 281, 281, 281, 281, 281, 281, 281, 281, 281,
	281, 281, 281, 281, 281, 281, 281, 281, 281, 281, 281, 281,
	281, 281, 281, 281, 281, 281, 281, 282, 283, 283, 283, 283,
	283, 283, 283, 283, 283, 283, 283, 283, 283, 283, 283, 283,
	283, 283, 284, 285, 286, 286, 286, 286, 286, 286, 286, 286,
	286, 286, 286, 286, 288, 291, 292, 293, 294, 295, 296, 296,
	296, 296, 296, 296, 296, 296, 297, 299, 301, 302, 302, 302,
	302, 302, 302, 302, 302, 303, 304, 305, 306, 306, 307, 308,
	308, 310, 312, 312, 312, 312, 312, 312, 312, 312, 312, 312,
	312, 312, 312, 312, 312, 312, 312, 312, 312, 314, 316, 316,
	316, 316, 316, 316, 316, 316, 316, 316, 316, 316, 316, 316,
	316, 316, 316, 316, 316, 316, 316, 316, 316, 316, 316, 316,
	316, 316, 316, 316, 316, 316, 316, 316, 317, 318, 318, 318,
	318, 318, 318, 318, 318, 318, 318, 318, 318, 318, 318, 318,
	318, 318, 318, 318, 319, 320, 320, 321, 322, 323, 324, 325,
	326, 326, 327, 328, 328, 328, 329, 330, 331, 332, 333, 334,
	334, 335, 336, 337, 338, 338, 339, 340, 341, 342, 343, 344,
	344, 345, 346, 347, 348, 349, 350, 351, 352, 352, 353, 354,
	355, 356, 357, 358, 358, 358, 358, 359, 360, 361, 362, 363,
	364, 365, 366, 367, 368, 369, 370, 371, 372, 373, 374, 375,
	375, 376, 377, 378, 379, 380, 381, 382, 383, 384, 385, 386,
	386, 387, 388, 389, 390, 391, 392, 393, 394, 395, 396, 397,
	397, 398, 399, 400, 401, 402, 403, 404, 405, 405, 405, 405,
	405, 405, 405, 405, 405, 405, 405, 405, 405, 405, 405, 405,
	405, 405, 405, 405, 406, 407, 408, 409, 409, 409, 409, 409,
	410, 411, 412, 413, 413, 413, 413, 413, 414, 415, 415, 415,
	415, 416, 417, 418, 418, 418, 418, 419, 420, 421, 421, 422,
	423, 424, 425, 426, 427, 428, 429, 430, 431, 432, 433, 434,
	435, 436, 437, 438, 438, 438, 438, 439, 440, 441, 442, 443,
	444, 445, 446, 447, 448, 449, 451, 452, 453, 454, 455, 455,
	456, 457, 458, 459, 460, 461, 462, 463, 464, 465, 466, 467,
	467, 468, 469, 470, 471, 472, 473, 475, 476, 477, 478, 479,
	480, 481, 482, 483, 484, 485, 486, 487, 488, 488, 488, 488,
	488, 488, 488, 488, 488, 488, 488, 488, 488, 488, 488, 488,
	488, 488, 488, 488, 488, 488, 488, 488, 488, 489, 490, 490,
	491, 492, 492, 493, 494, 495, 495, 495, 495, 496, 497, 498,
	499, 500, 500, 501, 502, 502, 502, 503, 504, 504, 504, 504,
	504, 504, 504, 505, 506, 507, 508, 509, 510, 511, 512, 513,
	514, 514, 515, 516, 516, 516, 516, 516, 516, 517, 518, 519,
	520, 521, 522, 523, 524, 525, 526, 528, 529, 530, 531, 532,
	532, 533, 534, 535, 536, 537, 538, 539, 540, 541, 542, 543,
	543, 544, 545, 546, 547, 548, 549, 550, 551, 551, 552, 553,
	553, 554, 555, 556, 557, 558, 559, 560, 561, 561, 561, 561,
	561, 561, 561, 561, 561, 561, 561, 561, 561, 561, 562, 563,
	563, 563, 563, 563, 563, 563, 563, 563, 563, 564, 565, 565,
	566, 567, 567, 568, 569, 570, 571, 571, 571, 571, 572, 573,
	573, 573, 573, 573, 573, 574, 575, 576, 577, 578, 578, 578,
	578, 578, 578, 579, 580, 580, 581, 582, 582, 582, 582, 582,
	582, 582, 582, 582, 582, 582, 582, 582, 582, 583, 584, 585,
	586, 587, 587, 587, 588, 589, 589, 589, 589, 589, 589, 589,
	590, 591, 591, 592, 594, 597, 600, 602, 602, 602, 602, 603,
	604, 605, 607, 609, 609, 609, 610, 611, 611, 612, 613, 614,
	615, 615, 617, 620, 622, 623, 624, 625, 628, 630, 630, 631,
	632, 632, 632, 632, 633, 635, 636, 636, 637, 638, 640, 641,
	641, 641, 642, 643, 644, 645, 645, 645, 645, 645, 645, 645,
	645, 645, 645, 645, 645, 645, 645, 645, 645, 645, 645, 645,
	645, 645, 645, 645, 645, 645, 645, 645, 645, 645, 645, 645,
	645, 645, 645, 645, 645, 645, 645, 645, 645, 645, 645, 645,
	645, 645, 645, 645, 645, 646, 647, 647, 647, 648, 649, 650,
	651, 652, 652, 652, 652, 652, 652, 652, 652, 652, 652, 652,
	652, 652, 653, 654, 655, 655, 657, 658, 659, 660, 661, 661,
	661, 662, 664, 666, 666, 666, 667, 668, 669, 669, 669,
};

static const int16_t spur_run[669][2] = {
	{-167, -162}, {-145, -139}, {-134, -128}, {-112, -105}, {-62, -56}, {-40, -34},
	{-167, -163}, {-145, -138}, {-134, -124}, {-112, -105}, {-62, -56}, {-40, -34},
	{-166, -162}, {-145, -140}, {-134, -123}, {-111, -105}, {-62, -56}, {-40, -34},
	{-167, -162}, {-145, -138}, {-134, -124}, {-112, -105}, {-63, -56}, {-40, -34},
	{-167, -162}, {-145, -139}, {-134, -124}, {-112, -105}, {-62, -56}, {-40, -34},
	{-145, -140}, {-134, -129}, {-112, -106}, {-62, -56}, {-40, -34}, {-166, -162},
	{-145, -139}, {-134, -125}, {-112, -105}, {-63, -56}, {-40, -34}, {-167, -162},
	{-146, -139}, {-134, -124}, {-112, -105}, {-63, -56}, {-51, -47}, {-40, -34},
	{-167, -162}, {-145, -139}, {-135, -124}, {-111, -106}, {-63, -56}, {-51, -47},
	{-40, -34}, {-29, -25}, {-167, -163}, {-145, -139}, {-134, -129}, {-111, -105},
	{-63, -56}, {-40, -34}, {-30, -25}, {-145, -140}, {-135, -129}, {-112, -106},
	{-63, -56}, {-40, -34}, {-30, -25}, {-145, -140}, {-134, -129}, {-112, -105},
	{-63, -56}, {-40, -34}, {-30, -26}, {-145, -140}, {-134, -129}, {-112, -106},
	{-63, -56}, {-52, -48}, {-40, -34}, {-145, -139}, {-134, -129}, {-112, -106},
	{-63, -56}, {-53, -49}, {-40, -34}, {1, 5}, {-146, -140}, {-135, -129},
	{-112, -106}, {-63, -57}, {-53, -49}, {-40, -34}, {1, 5}, {-167, -163},
	{-146, -140}, {-135, -129}, {-112, -106}, {-63, -57}, {-54, -49}, {-40, -34},
	{-5, -1}, {-166, -162}, {-145, -139}, {-134, -124}, {-112, -106}, {-63, -57},
	{-54, -49}, {-40, -34}, {-32, -27}, {-167, -163}, {-146, -140}, {-134, -125},
	{-112, -106}, {-63, -50}, {-46, -42}, {-40, -34}, {-32, -28}, {-167, -163},
	{-145, -140}, {-135, -125}, {-111, -106}, {-63, -57}, {-54, -50}, {-40, -28},
	{-168, -163}, {-146, -140}, {-134, -125}, {-112, -106}, {-63, -57}, {-55, -50},
	{-40, -28}, {-167, -163}, {-145, -140}, {-135, -125}, {-112, -106}, {-63, -50},
	{-46, -29}, {-146, -140}, {-134, -124}, {-112, -106}, {-63, -51}, {-40, -29},
	{-146, -141}, {-134, -129}, {-112, -106}, {-63, -51}, {-41, -29}, {-167, -163},
	{-146, -140}, {-134, -129}, {-112, -106}, {-68, -51}, {-40, -29}, {-167, -163},
	{-146, -140}, {-135, -125}, {-112, -102}, {-63, -51}, {-45, -30}, {-146, -140},
	{-134, -125}, {-112, -102}, {-63, -52}, {-44, -30}, {-146, -140}, {-134, -129},
	{-112, -107}, {-67, -52}, {-45, -30}, {-146, -141}, {-135, -129}, {-112, -107},
	{-68, -52}, {-44, -31}, {-167, -163}, {-146, -141}, {-135, -130}, {-112, -106},
	{-67, -53}, {-44, -31}, {-168, -164}, {-146, -141}, {-134, -129}, {-112, -103},
	{-67, -53}, {-44, -31}, {-135, -130}, {-111, -104}, {-67, -53}, {-43, -31},
	{-135, -130}, {-112, -104}, {-71, -54}, {-43, -32}, {-145, -138}, {-134, -127},
	{-111, -104}, {-66, -51}, {-43, -29}, {-143, -139}, {-112, -104}, {-69, -52},
	{-43, -30}, {1, 5}, {-134, -130}, {-111, -103}, {-66, -52}, {-45, -31},
	{-5, -1}, {-142, -138}, {-133, -128}, {-112, -103}, {-62, -53}, {-39, -30},
	{1, 5}, {-144, -138}, {-110, -105}, {-65, -53}, {-41, -30}, {-144, -140},
	{-134, -125}, {-110, -104}, {-63, -53}, {-42, -30}, {-141, -137}, {-133, -127},
	{-107, -103}, {-63, -53}, {-43, -30}, {-143, -138}, {-131, -127}, {-109, -104},
	{-65, -53}, {-40, -31}, {-143, -139}, {-132, -127}, {-110, -103}, {-66, -53},
	{-41, -30}, {-131, -126}, {-109, -104}, {-64, -53}, {-40, -30}, {-142, -136},
	{-110, -102}, {-64, -53}, {-40, -30}, {-146, -142}, {-132, -125}, {-113, -107},
	{-62, -52}, {-41, -35}, {-132, -126}, {-62, -52}, {1, 5}, {-138, -133},
	{-67, -61}, {2, 6}, {1, 5}, {-5, -1}, {-5, -1}, {-5, -1},
	{1, 5}, {-5, -1}, {1, 5}, {1, 5}, {-5, -1}, {-5, -1},
	{-5, -1}, {-5, -1}, {-5, -1}, {-5, -1}, {-5, -1}, {1, 5},
	{-5, -1}, {-5, -1}, {-5, -1}, {1, 5}, {-5, -1}, {1, 5},
	{1, 5}, {205, 211}, {210, 216}, {204, 208}, {45, 49}, {99, 103},
	{40, 44}, {86, 90}, {93, 98}, {80, 84}, {47, 51}, {49, 53},
	{90, 94}, {88, 92}, {-83, -79}, {-79, -75}, {150, 154}, {-179, -175},
	{154, 159}, {-173, -169}, {24, 28}, {27, 34}, {182, 186}, {185, 189},
	{-5, -1}, {-5, -1}, {-208, -204}, {-63, -58}, {-202, -198}, {-57, -52},
	{-212, -208}, {-166, -162}, {-208, -202}, {-167, -163}, {-150, -139}, {-149, -142},
	{-215, -211}, {-211, -207}, {-203, -198}, {-198, -194}, {-194, -190}, {-190, -185},
	{-186, -182}, {-181, -177}, {-173, -168}, {-168, -164}, {-156, -151}, {-152, -147},
	{-147, -143}, {-143, -138}, {-139, -134}, {-135, -130}, {-126, -121}, {-121, -117},
	{-117, -113}, {-113, -109}, {-105, -100}, {-100, -96}, {-96, -92}, {-92, -87},
	{-87, -83}, {-83, -79}, {-75, -71}, {-70, -66}, {-66, -62}, {-62, -58},
	{-58, -53}, {-53, -49}, {-49, -45}, {-45, -41}, {-36, -32}, {-32, -28},
	{-28, -24}, {-23, -19}, {-19, -15}, {-15, -11}, {2, 6}, {7, 11},
	{11, 15}, {15, 19}, {19, 24}, {23, 28}, {28, 32}, {32, 36},
	{36, 41}, {40, 45}, {45, 49}, {49, 53}, {53, 58}, {57, 62},
	{62, 67}, {66, 71}, {70, 75}, {79, 84}, {83, 88}, {87, 92},
	{91, 96}, {96, 101}, {100, 105}, {104, 109}, {109, 113}, {113, 117},
	{117, 122}, {121, 126}, {130, 135}, {134, 139}, {139, 143}, {143, 148},
	{147, 151}, {151, 156}, {156, 160}, {160, 164}, {164, 169}, {168, 173},
	{173, 177}, {181, 186}, {185, 190}, {190, 194}, {194, 199}, {198, 203},
	{202, 207}, {207, 211}, {211, 216}, {-215, -211}, {-211, -207}, {-207, -203},
	{-203, -199}, {-182, -177}, {-177, -173}, {-173, -168}, {-168, -164}, {-147, -143},
	{-143, -139}, {-126, -122}, {-122, -117}, {-117, -113}, {-100, -96}, {-96, -92},
	{-92, -88}, {-83, -79}, {-79, -75}, {-75, -71}, {-70, -66}, {-67, -61},
	{-62, -57}, {-58, -53}, {-53, -49}, {-49, -45}, {-44, -40}, {-41, -36},
	{-36, -32}, {-32, -27}, {-28, -23}, {-24, -19}, {-19, -15}, {-15, -11},
	{2, 7}, {6, 11}, {11, 15}, {15, 19}, {19, 24}, {23, 28},
	{28, 32}, {32, 36}, {36, 41}, {40, 45}, {45, 49}, {49, 54},
	{175, 179}, {169, 173}, {57, 62}, {62, 66}, {66, 71}, {75, 79},
	{79, 84}, {83, 88}, {87, 92}, {92, 96}, {96, 100}, {100, 105},
	{105, 109}, {109, 113}, {113, 117}, {117, 121}, {122, 126}, {130, 134},
	{134, 139}, {139, 143}, {143, 147}, {147, 151}, {-132, -128}, {-138, -134},
	{155, 160}, {160, 165}, {164, 169}, {168, 173}, {172, 177}, {177, 181},
	{181, 186}, {185, 190}, {189, 195}, {194, 198}, {198, 203}, {202, 207},
	{207, 211}, {211, 215}, {-194, -190}, {-190, -186}, {-181, -177}, {-177, -173},
	{-169, -165}, {-164, -160}, {-160, -156}, {-143, -139}, {-139, -135}, {-134, -130},
	{-130, -126}, {-126, -122}, {-117, -113}, {-113, -109}, {-100, -96}, {-96, -92},
	{-67, -62}, {-62, -57}, {-58, -53}, {-54, -49}, {-49, -45}, {-45, -41},
	{-40, -36}, {-36, -32}, {-32, -28}, {-28, -23}, {-19, -15}, {-15, -11},
	{11, 15}, {15, 19}, {19, 24}, {23, 28}, {28, 32}, {32, 36},
	{36, 41}, {41, 45}, {45, 49}, {49, 53}, {53, 57}, {62, 66},
	{58, 62}, {62, 66}, {66, 71}, {70, 75}, {79, 84}, {83, 87},
	{87, 92}, {92, 96}, {96, 101}, {100, 104}, {105, 109}, {108, 113},
	{113, 117}, {117, 122}, {122, 126}, {130, 135}, {134, 139}, {139, 143},
	{143, 147}, {147, 152}, {151, 156}, {156, 160}, {160, 165}, {169, 173},
	{173, 177}, {181, 186}, {185, 190}, {190, 194}, {194, 198}, {198, 203},
	{203, 207}, {207, 211}, {211, 216}, {1, 5}, {1, 5}, {-194, -189},
	{-190, -186}, {-181, -177}, {-177, -173}, {-169, -164}, {-164, -160}, {-160, -156},
	{-156, -152}, {-138, -134}, {-134, -130}, {-109, -105}, {-104, -100}, {-100, -96},
	{-96, -92}, {-92, -88}, {-67, -62}, {-62, -58}, {-54, -49}, {-49, -45},
	{11, 15}, {15, 19}, {19, 24}, {24, 28}, {28, 32}, {41, 45},
	{45, 49}, {75, 79}, {79, 83}, {-81, -77}, {-75, -71}, {93, 99},
	{96, 100}, {103, 107}, {196, 201}, {89, 94}, {100, 105}, {202, 207},
	{94, 98}, {105, 109}, {24, 29}, {19, 23}, {13, 18}, {135, 139},
	{202, 207}, {139, 143}, {201, 205}, {54, 65}, {57, 62}, {164, 169},
	{169, 173}, {172, 177}, {177, 181}, {43, 47}, {186, 190}, {-207, -202},
	{47, 53}, {190, 194}, {-213, -208}, {194, 198}, {198, 203}, {203, 207},
	{207, 211}, {-135, -129}, {-127, -122}, {-28, -23}, {-130, -126}, {-28, -24},
	{-132, -125}, {-130, -126}, {1, 5}, {-143, -139}, {-5, -1}, {-148, -143},
	{-198, -194}, {-194, -190}, {-207, -203}, {-196, -191}, {-209, -203}, {1, 5},
	{-5, -1}, {1, 5}, {-5, -1}, {-6, -2}, {-5, -1}, {-5, -1},
	{-5, -1}, {1, 5}, {1, 5}, {-5, -1}, {1, 5}, {2, 6},
	{1, 5}, {-5, -1}, {1, 5}, {1, 5}, {1, 5}, {1, 5},
	{1, 5}, {130, 134}, {-6, -1}, {135, 139}, {-5, -1}, {1, 5},
	{-5, -1}, {1, 5}, {1, 5},
};
```
