## boards/shields/m5stack_cardputer_adv/Kconfig.defconfig
```kconfig
# SPDX-License-Identifier: GPL-3.0-or-later

if SHIELD_M5STACK_CARDPUTER_ADV

config DISPLAY
	default y

config I2C
	default y

endif # SHIELD_M5STACK_CARDPUTER_ADV
```

## boards/shields/m5stack_cardputer_adv/Kconfig.shield
```kconfig
# SPDX-License-Identifier: GPL-3.0-or-later

config SHIELD_M5STACK_CARDPUTER_ADV
	def_bool $(shields_list_contains,m5stack_cardputer_adv)
```
